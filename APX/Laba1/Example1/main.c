/* 	Пример 1.
 	Управление портами ввода/вывода.

    Для правильного связывания модулей отметить
    Options -> Linker -> Use Memory Layout from Target Dialog
*/
                  
#include <LPC23xx.H>                       /* Описание LPC23xx */


void delay(void) {

	unsigned int i;
	for (i=0;i<0xfffff;i++){}
		for (i=0;i<0xfffff;i++){}
			for (i=0;i<0xfffff;i++){}
				for (i=0;i<0xfffff;i++){}
}

int main (void) {
 
//Конфигурировать функции входов/выходов порта 0 на модуль GPIO  	   
  PINSEL3 	= 0x00000000;
//IODIR1 - Регистр направления ввода вывода (1 - вывод; 0 - ввод)
  IODIR1 = 0x1C000000; /* P0.26..28 программируем на вывод, остальные на ввод */
//IOSET1 - Регистр установки порта (1 - установк; 0 - нет изменений)
 // IOSET1 = 0x00000000; /* Устанавливаем высокий уровень на выходах (гасим светодиоды) */

//27 помол
//26 заварка	
	//28 нагрев
	//29 кнопка
	
	IOCLR1=0xffffffff;
	IOSET1 =(1<<28);	//boiler
		
  while (1) {          /* Бесконечный цикл */
		//29 кнопка	
		//Если PORT1.29=1
		if (!(IOPIN1 & (1<<29)))
		{
			//27 помол
			IOSET1 =(1<<27);
			delay();              /* Задержка */
			//26 заварка
			IOSET1 =(1<<26);
			delay(); 
			
			IOCLR1 = (1<<26);//cброс			
			IOCLR1 = (1<<27);//сброс			
			
			while(!(IOPIN1 & (1<<29))){};
			
		}		
	}
		
}

